## receiver/main/Kconfig.projbuild
```kconfig
menu "Wireless DAP receiver"

config WIRELESS_DAP_LED_GPIO
    int "WS2812 data GPIO"
    range 0 48
    default 48

config WIRELESS_DAP_PAIR_ID
    hex "Pair identifier"
    default 0x57444150
    help
        Both boards must use the same value. It separates nearby probe pairs.

config WIRELESS_DAP_WIFI_CHANNEL
    int "ESP-NOW Wi-Fi channel"
    range 1 13
    default 6

config WIRELESS_DAP_PROTOCOL_VERSION
    int "Wireless protocol version"
    range 1 2
    default 1
    help
        Version 1 is the stable 64-byte HID baseline. Version 2 enables the
        capability negotiation and ESP-NOW v2 discovery frame; both boards
        must use the same value and support ESP-NOW v2.

config WIRELESS_DAP_V2_PACKET_WINDOW
    int "Protocol v2 packet window"
    range 1 2
    default 1
    depends on WIRELESS_DAP_PROTOCOL_VERSION = 2
    help
        Accept one or two independent DAP requests in flight. Requests are
        always executed in window order. A receiver configured for 2 remains
        compatible with a transmitter using window 1.

choice WIRELESS_DAP_V2_DAP_PACKET_SIZE
    prompt "Protocol v2 DAP packet size"
    default WIRELESS_DAP_V2_DAP_PACKET_64
    depends on WIRELESS_DAP_PROTOCOL_VERSION = 2

config WIRELESS_DAP_V2_DAP_PACKET_64
    bool "64 bytes"

config WIRELESS_DAP_V2_DAP_PACKET_256
    bool "256 bytes"

endchoice

config WIRELESS_DAP_DAP_PACKET_SIZE
    int
    default 256 if WIRELESS_DAP_V2_DAP_PACKET_256
    default 64

config WIRELESS_DAP_HID_AGGREGATION
    bool "Enable HID64 request aggregation support"
    default n
    depends on WIRELESS_DAP_PROTOCOL_VERSION = 2
    depends on WIRELESS_DAP_V2_DAP_PACKET_256
    depends on WIRELESS_DAP_V2_PACKET_WINDOW = 1
    help
        Advertise support for transmitter-side HID64 aggregation using the
        standard DAP_ExecuteCommands wrapper. Enable the matching transmitter
        option.

config WIRELESS_DAP_TX_DELAY_MS
    int "ESP-NOW TX pacing delay (ms)"
    range 0 20
    default 2
    help
        Delay after an accepted ESP-NOW frame. Keep 2 ms for the original
        baseline; use 0 or 1 ms only after checking send failures.

config WIRELESS_DAP_ESPNOW_PHY_RATE
    int "ESP-NOW peer PHY rate"
    range 0 3
    default 0
    help
        0: driver default, 1: 11 Mbps, 2: HT20 MCS2, 3: HT20 MCS3.

config WIRELESS_DAP_DAP_RETRY_MS
    int "DAP response retry interval (ms)"
    range 5 200
    default 45

config WIRELESS_DAP_DIAGNOSTICS
    bool "Enable wireless performance diagnostics"
    default n
    help
        Log DAP latency and a five-second wireless link statistics summary.

config WIRELESS_DAP_UART_TX_GPIO
    int "Target UART TX GPIO"
    range 0 48
    default 17

config WIRELESS_DAP_UART_RX_GPIO
    int "Target UART RX GPIO"
    range 0 48
    default 18

config WIRELESS_DAP_UART_BAUD
    int "Initial target UART baud rate"
    range 1200 3000000
    default 115200

config WIRELESS_DAP_SWD_CLK_GPIO
    int "Target SWCLK GPIO"
    range 0 48
    default 9

config WIRELESS_DAP_SWD_DEFAULT_CLOCK_HZ
    int "Default SWD clock (Hz)"
    range 100000 8000000
    default 1000000
    help
        Used until the host sends DAP_SWJ_Clock. Validate 2-4 MHz on the
        target and wiring before selecting a higher value.

config WIRELESS_DAP_SWD_IO_GPIO
    int "Target SWDIO GPIO"
    range 0 48
    default 10

config WIRELESS_DAP_RESET_GPIO
    int "Target nRESET GPIO"
    range 0 48
    default 4

endmenu
```

## transmitter/main/Kconfig.projbuild
```kconfig
menu "Wireless DAP transmitter"

config WIRELESS_DAP_LED_GPIO
    int "WS2812 data GPIO"
    range 0 48
    default 48

config WIRELESS_DAP_PAIR_ID
    hex "Pair identifier"
    default 0x57444150
    help
        Both boards must use the same value. It separates nearby probe pairs.

config WIRELESS_DAP_WIFI_CHANNEL
    int "ESP-NOW Wi-Fi channel"
    range 1 13
    default 6

config WIRELESS_DAP_PROTOCOL_VERSION
    int "Wireless protocol version"
    range 1 2
    default 1
    help
        Version 1 is the stable 64-byte HID baseline. Version 2 enables the
        capability negotiation and ESP-NOW v2 discovery frame; both boards
        must use the same value and support ESP-NOW v2.

config WIRELESS_DAP_V2_PACKET_WINDOW
    int "Protocol v2 packet window"
    range 1 2
    default 1
    depends on WIRELESS_DAP_PROTOCOL_VERSION = 2
    help
        Allow one or two independent DAP requests in flight. The receiver
        always executes requests in order. Both boards must support the
        selected window; start with 1 for compatibility.

config WIRELESS_DAP_WINDOW_WAIT_MS
    int "Packet window collection wait (ms)"
    range 0 10
    default 1
    depends on WIRELESS_DAP_V2_PACKET_WINDOW = 2
    help
        Time to wait for a second USB DAP request before sending a one-item
        wireless window.

config WIRELESS_DAP_USB_BULK_V2
    bool "Enable experimental CMSIS-DAP v2 bulk USB interface"
    default n
    depends on WIRELESS_DAP_PROTOCOL_VERSION = 2
    depends on TINYUSB_VENDOR_COUNT = 1
    help
        Add a CMSIS-DAP v2 vendor-specific bulk interface alongside the
        stable HID interface and CDC ACM. Set TinyUSB Vendor specific
        interfaces count to 1 before enabling this option.

choice WIRELESS_DAP_V2_DAP_PACKET_SIZE
    prompt "Protocol v2 DAP packet size"
    default WIRELESS_DAP_V2_DAP_PACKET_64
    depends on WIRELESS_DAP_PROTOCOL_VERSION = 2

config WIRELESS_DAP_V2_DAP_PACKET_64
    bool "64 bytes"

config WIRELESS_DAP_V2_DAP_PACKET_256
    bool "256 bytes"

endchoice

config WIRELESS_DAP_DAP_PACKET_SIZE
    int
    default 256 if WIRELESS_DAP_V2_DAP_PACKET_256
    default 64

config WIRELESS_DAP_HID_AGGREGATION
    bool "Enable experimental HID64 request aggregation"
    default n
    depends on WIRELESS_DAP_PROTOCOL_VERSION = 2
    depends on WIRELESS_DAP_V2_DAP_PACKET_256
    depends on WIRELESS_DAP_V2_PACKET_WINDOW = 1
    help
        Advertise three HID packet slots and combine up to three compatible
        64-byte CMSIS-DAP requests into one 256-byte wireless exchange. Enable
        the matching receiver option. Bulk requests remain unaggregated.

config WIRELESS_DAP_HID_AGGREGATION_WAIT_MS
    int "HID aggregation wait (ms)"
    range 0 10
    default 1
    depends on WIRELESS_DAP_HID_AGGREGATION
    help
        Time to wait for a second HID request after receiving the first one.
        Any additional already queued request is collected without waiting.

config WIRELESS_DAP_TX_DELAY_MS
    int "ESP-NOW TX pacing delay (ms)"
    range 0 20
    default 2
    help
        Delay after an accepted ESP-NOW frame. Keep 2 ms for the original
        baseline; use 0 or 1 ms only after checking send failures.

config WIRELESS_DAP_ESPNOW_PHY_RATE
    int "ESP-NOW peer PHY rate"
    range 0 3
    default 0
    help
        0: driver default, 1: 11 Mbps, 2: HT20 MCS2, 3: HT20 MCS3.

config WIRELESS_DAP_DAP_RETRY_MS
    int "DAP response retry interval (ms)"
    range 5 200
    default 45

config WIRELESS_DAP_DIAGNOSTICS
    bool "Enable wireless performance diagnostics"
    default n
    help
        Log DAP latency and a five-second wireless link statistics summary.

endmenu
```
